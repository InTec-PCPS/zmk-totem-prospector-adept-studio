## boards/shields/totem/board.yml
```yaml
boards:
  - name: xiao_ble
    vendor: seeeduino
  - name: xiao_ble
    vendor: seeeduino
  - name: xiao_ble
    vendor: seeeduino
  - name: xiao_ble
    vendor: seeeduino
socs:
  - name: <nrf52840>
  - name: <nrf52840>
  - name: <nrf52840>
  - name: <nrf52840>
```

## config/west.yml
```yaml
manifest:
  remotes:
    - name: zmkfirmware
      url-base: https://github.com/zmkfirmware
    - name: badjeff
      url-base: https://github.com/badjeff
    - name: cyboard
      url-base: https://github.com/Cyboard-DigitalTailor
    - name: carrefinho
      url-base: https://github.com/carrefinho
  projects:
    - name: zmk
      remote: zmkfirmware
      revision: v0.2
      import: app/west.yml
    - name: zmk-pmw3610-driver
      remote: badjeff
      revision: main
#    - name: zmk-pwm3610-driver
#      remote: cyboard
#      revision: startup_optimization
    - name: prospector-zmk-module
      remote: carrefinho
      revision: feat/new-status-screens
  self:
    path: config
```
